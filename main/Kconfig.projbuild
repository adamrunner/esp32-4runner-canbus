## main/Kconfig.projbuild
```kconfig
menu "4Runner Display Board"

    choice BOARD_MODEL
        prompt "Waveshare board"
        default BOARD_WAVESHARE_LCD_43B
        help
            Selects the panel resolution and RGB timing. Both boards share the same
            pins and CH422G wiring.

        config BOARD_WAVESHARE_LCD_43B
            bool "ESP32-S3-Touch-LCD-4.3B (800x480)"

        config BOARD_WAVESHARE_LCD_5B
            bool "ESP32-S3-Touch-LCD-5B (1024x600)"
    endchoice

endmenu

menu "Example Configuration"

    config EXAMPLE_TX_GPIO_NUM
        int "TX GPIO number"
        default 21 if IDF_TARGET_ESP32
        default 0
        help
            This option selects the GPIO pin used for the TX signal. Connect the
            TX signal to your transceiver.

    config EXAMPLE_RX_GPIO_NUM
        int "RX GPIO number"
        default 22 if IDF_TARGET_ESP32
        default 2
        help
            This option selects the GPIO pin used for the RX signal. Connect the
            RX signal to your transceiver.

endmenu
```
